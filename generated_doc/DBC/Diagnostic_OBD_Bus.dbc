VERSION ""

NS_ :

BS_:

BU_: AEC_CABIN_01 AEC_ENGINE_01

BO_ 2566834688 EngineDiagnostics: 2 AEC_ENGINE_01
 SG_ Active_DTC_Count : 0|8@1+ (1,0) [0|255] "" Vector__XXX
 SG_ MIL_Status : 8|1@1+ (1,0) [0|1] "" Vector__XXX

BO_ 2364539392 CabinBroadcast: 3 AEC_CABIN_01
 SG_ Display_Vehicle_Speed : 0|16@1+ (0.01,0) [0|6000] "Hz" Vector__XXX
 SG_ Cluster_Warning_Flags : 16|8@1+ (1,0) [0|255] "" Vector__XXX
